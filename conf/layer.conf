## conf/layer.conf
```bitbake
# We have a conf and classes directory, append to BBPATH
BBPATH .= ":${LAYERDIR}"

# We have a recipes directory, add to BBFILES
BBFILES += "${LAYERDIR}/recipes*/*/*.bb ${LAYERDIR}/recipes*/*/*.bbappend ${LAYERDIR}/images/*.bb"

BBFILE_COLLECTIONS += "meta-cap"
BBFILE_PATTERN_meta-cap := "^${LAYERDIR}/"
BBFILE_PRIORITY_meta-cap = "20"

LAYERSERIES_COMPAT_meta-cap = "gatesgarth hardknott"
```
